## board/samsung/tq2440/Kconfig
```kconfig
if TARGET_TQ2440

config SYS_BOARD
	default "TQ2440"

config SYS_VENDOR
	default "samsung"

config SYS_SOC
	default "s3c24x0"

config SYS_CONFIG_NAME
	default "smdk2410"

endif
```
